/dts-v1/;
/plugin/;
/ {
    compatible = "brcm,bcm2711";

    fragment@0 {
        target-path = "/";
        __overlay__ {
            pd {
                compatible = "dts,pd";
            };

            gpiol {
                compatible = "dts,gpiol";
                gpios = < 0x0f 0x08 0x00 >; 
            };
        };
    };
};